## config/west.yml
```yaml
manifest:
  remotes:
    - name: zmkfirmware
      url-base: https://github.com/zmkfirmware
    - name: jaredthejellyfish 
      url-base: https://github.com/jaredthejellyfish 
  projects:
    - name: zmk
      remote: zmkfirmware
      revision: main
      import: app/west.yml
    - name: nice-view-lily 
      remote: jaredthejellyfish 
      revision: main 
  self:
    path: config
```
